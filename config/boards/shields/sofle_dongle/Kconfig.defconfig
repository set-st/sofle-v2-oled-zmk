## config/boards/shields/sofle_dongle/Kconfig.defconfig
```kconfig
if SHIELD_SOFLE_DONGLE

config ZMK_KEYBOARD_NAME
    default "Sofle Dongle"
config ZMK_SPLIT
    default y
config ZMK_SPLIT_BLE
    default y
config ZMK_SPLIT_ROLE_CENTRAL
    default y
config ZMK_SPLIT_BLE_CENTRAL_PERIPHERALS
    default 2
config BT_MAX_CONN
    default 7
config BT_MAX_PAIRED
    default 7
config ZMK_KSCAN_MOCK
    bool
    default y
config ZMK_STUDIO
    bool
    default y
config ZMK_RPC
    bool
    default y
config ZMK_STUDIO_MAX_KEYBOARDS
    int
    default 2

endif
```

## config/boards/shields/sofle_dongle/Kconfig.shield
```kconfig
config SHIELD_SOFLE_DONGLE
    def_bool $(shields_list_contains,sofle_dongle)
    select ZMK_SPLIT_BLE
    select ZMK_SPLIT_ROLE_CENTRAL
    select ZMK_STUDIO
    imply ZMK_BLE
    imply PROSPECTOR_ADAPTER
```
